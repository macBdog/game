const char * globalFragmentShader = 
"#version 400\n"
"uniform sampler2D DiffuseTexture; \n"
"uniform sampler2D NormalTexture; \n"
"uniform sampler2D SpecularTexture; \n"
"uniform sampler2D GBuffer1; \n"
"uniform sampler2D GBuffer2; \n"
"uniform sampler2D GBuffer3; \n"
"uniform sampler2D GBuffer4; \n"
"uniform sampler2D GBuffer5; \n"
"uniform sampler2D GBuffer6; \n"
"uniform int MaterialShininess; \n"
"uniform int NumActiveLights; \n"
"uniform vec3 MaterialAmbient; \n"
"uniform vec3 MaterialDiffuse; \n"
"uniform vec3 MaterialSpecular; \n"
"uniform vec3 MaterialEmission; \n"
"uniform float Time; \n"
"uniform float LifeTime; \n"
"uniform float FrameTime; \n"
"uniform float ViewWidth; \n"
"uniform float ViewHeight; \n"
"uniform vec3 ShaderData; \n"
"uniform mat4 ObjectMatrix; \n"
"uniform mat4 ViewMatrix; \n"
"uniform mat4 ProjectionMatrix; \n"
"uniform float Lights[4*((4*3)+1)]; \n"
"layout(location = 0) out vec4 FragmentColour;\n"
"layout(location = 1) out vec4 GBuffer1Colour;\n"
"layout(location = 2) out vec4 GBuffer2Colour;\n"
"layout(location = 3) out vec4 GBuffer3Colour;\n"
"layout(location = 4) out vec4 GBuffer4Colour;\n"
"layout(location = 5) out vec4 GBuffer5Colour;\n"
"layout(location = 6) out vec4 GBuffer6Colour;\n"
;