const char * vrFragmentShader = 
"uniform sampler2D tex;\n"
"uniform float time;\n"
"uniform float frameTime;\n" 
"uniform float viewWidth;\n"
"uniform float viewHeight;\n"
"uniform vec2 LensCenter;\n"
"uniform vec2 ScreenCenter;\n"
"uniform vec2 Scale;\n"
"uniform vec2 ScaleIn;\n"
"uniform vec4 HmdWarpParam;\n"
"\n"
"vec2 HmdWarp(vec2 texIn)\n"
"{\n"
"   vec2 theta = (texIn - LensCenter) * ScaleIn;\n"
"   float  rSq= theta.x * theta.x + theta.y * theta.y;\n"
"   vec2 theta1 = theta * (HmdWarpParam.x + HmdWarpParam.y * rSq + "
"           HmdWarpParam.z * rSq * rSq + HmdWarpParam.w * rSq * rSq * rSq);\n"
"   return LensCenter + Scale * theta1;\n"
"}\n"
"\n"
"void main()\n"
"{\n"
"   vec2 tc = HmdWarp(gl_TexCoord[0]);\n"
"   if (any(notEqual(clamp(tc, ScreenCenter-vec2(0.25,0.5), ScreenCenter+vec2(0.25, 0.5)) - tc, vec2(0.0, 0.0))))\n"
"       gl_FragColor = vec4(0.0, 1.0, 0.0, 1.0);\n"
"   else\n"
"       gl_FragColor = texture2D(tex, tc);\n"
"}";