const char * particleGeometryShader = 
"#version 400\n"
"layout (points) in;\n"
"layout (triangle_strip, max_vertices = 4) out;\n"
"uniform mat4 ViewMatrix;\n"
"uniform mat4 ProjectionMatrix;\n"
"in Particle \n"
"{ \n"
"	vec3 Position;\n"
"	vec4 Colour;\n"
"   float Size;\n"
"} particle[];\n"
"\n"
"out Fragment\n"
"{\n"
"	vec2 UV;\n"
"	vec4 Colour;\n"
"} fragment;\n"
"\n"
"void main()\n"
"{\n"
"	fragment.Colour = particle[0].Colour;\n"
"	vec4 center = vec4(particle[0].Position, 1);\n"
"	mat4 bbMat = inverse(transpose(ViewMatrix));\n"
"   float sZ = particle[0].Size;\n"
"	vec4 bR = bbMat[0] * sZ;\n"
"	vec4 bU = bbMat[1] * sZ;\n"
"\n"
"	vec2 uv = vec2(-1, -1);\n"
"	vec4 p = center - bR - bU;\n"
"	fragment.UV = uv;\n"
"	gl_Position = p * ViewMatrix * ProjectionMatrix;\n"
"	EmitVertex();\n"
"\n"
"	uv = vec2(1, -1);\n"
"	p = center + bR - bU;\n"
"	fragment.UV = uv;\n"
"	gl_Position = p * ViewMatrix * ProjectionMatrix;\n"
"	EmitVertex();\n"
"\n"
"	uv = vec2(-1, 1);\n"
"	p = center - bR + bU;\n"
"	fragment.UV = uv;\n"
"	gl_Position = p * ViewMatrix * ProjectionMatrix;\n"
"	EmitVertex();\n"
"\n"
"	uv = vec2(1, 1);\n"
"	p = center + bR + bU;\n"
"	fragment.UV = uv;\n"
"	gl_Position = p * ViewMatrix * ProjectionMatrix;\n"
"	EmitVertex();\n"
"	EndPrimitive();\n"
"}\n"
;