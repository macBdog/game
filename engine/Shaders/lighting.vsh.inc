const char * lightingVertexShader = 
"#version 400\n"
"in vec3 VertexPosition;\n"
"in vec4 VertexColour;\n"
"in vec2 VertexUV;\n"
"in vec3 VertexNormal;\n"
"out vec2 OutTexCoord;\n"
"out vec4 LightVertexPos; \n"
"out vec3 LightVertexNormal; \n"
"uniform mat4 ObjectMatrix;\n"
"uniform mat4 ViewMatrix;\n"
"uniform mat4 ProjectionMatrix;\n"
"out vec4 Colour;\n"
"void main(void)  \n"
"{ \n"
"	LightVertexPos = vec4(VertexPosition, 1.0) * ObjectMatrix;\n"
"	LightVertexNormal = VertexNormal;\n"
"	OutTexCoord = VertexUV;\n"
"	gl_Position = vec4(VertexPosition, 1.0) * ObjectMatrix * ViewMatrix * ProjectionMatrix;\n"
"} \n";