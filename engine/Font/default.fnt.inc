const char * defaultFontDefinition =
"info face='default' size=40 bold=1 italic=0 charset='' unicode=1 stretchH=100 smooth=1 aa=4 padding=0,0,0,0 spacing=1,1 outline=0\n"
"common lineHeight=40 base=32 scaleW=256 scaleH=256 pages=1 packed=0 alphaChnl=1 redChnl=0 greenChnl=0 blueChnl=0\n"
"page id=0 file='default.tga'\n"
"chars count=95\n"
"char id=32   x=254   y=24    width=1     height=1     xoffset=0     yoffset=31    xadvance=7     page=0  chnl=15\n"
"char id=33   x=108   y=30    width=5     height=23    xoffset=3     yoffset=9     xadvance=10    page=0  chnl=15\n"
"char id=34   x=46    y=119   width=10    height=10    xoffset=1     yoffset=8     xadvance=14    page=0  chnl=15\n"
"char id=35   x=215   y=47    width=16    height=22    xoffset=0     yoffset=10    xadvance=16    page=0  chnl=15\n"
"char id=36   x=0     y=0     width=15    height=30    xoffset=1     yoffset=6     xadvance=16    page=0  chnl=15\n"
"char id=37   x=177   y=0     width=23    height=23    xoffset=1     yoffset=9     xadvance=24    page=0  chnl=15\n"
"char id=38   x=201   y=0     width=21    height=23    xoffset=1     yoffset=9     xadvance=23    page=0  chnl=15\n"
"char id=39   x=65    y=118   width=4     height=10    xoffset=1     yoffset=8     xadvance=7     page=0  chnl=15\n"
"char id=40   x=73    y=0     width=8     height=29    xoffset=1     yoffset=8     xadvance=10    page=0  chnl=15\n"
"char id=41   x=91    y=0     width=7     height=29    xoffset=1     yoffset=8     xadvance=10    page=0  chnl=15\n"
"char id=42   x=17    y=119   width=13    height=14    xoffset=2     yoffset=8     xadvance=16    page=0  chnl=15\n"
"char id=43   x=223   y=93    width=15    height=16    xoffset=0     yoffset=14    xadvance=16    page=0  chnl=15\n"
"char id=44   x=57    y=119   width=7     height=10    xoffset=0     yoffset=26    xadvance=8     page=0  chnl=15\n"
"char id=45   x=118   y=118   width=9     height=4     xoffset=0     yoffset=21    xadvance=10    page=0  chnl=15\n"
"char id=46   x=94    y=118   width=5     height=6     xoffset=2     yoffset=26    xadvance=8     page=0  chnl=15\n"
"char id=47   x=16    y=0     width=14    height=30    xoffset=0     yoffset=7     xadvance=14    page=0  chnl=15\n"
"char id=48   x=0     y=78    width=15    height=22    xoffset=0     yoffset=10    xadvance=16    page=0  chnl=15\n"
"char id=49   x=173   y=72    width=13    height=22    xoffset=2     yoffset=10    xadvance=16    page=0  chnl=15\n"
"char id=50   x=16    y=78    width=15    height=22    xoffset=1     yoffset=10    xadvance=16    page=0  chnl=15\n"
"char id=51   x=158   y=74    width=14    height=22    xoffset=1     yoffset=10    xadvance=16    page=0  chnl=15\n"
"char id=52   x=198   y=47    width=16    height=22    xoffset=0     yoffset=10    xadvance=16    page=0  chnl=15\n"
"char id=53   x=143   y=74    width=14    height=22    xoffset=1     yoffset=10    xadvance=16    page=0  chnl=15\n"
"char id=54   x=232   y=47    width=15    height=22    xoffset=1     yoffset=10    xadvance=16    page=0  chnl=15\n"
"char id=55   x=32    y=78    width=15    height=22    xoffset=1     yoffset=10    xadvance=16    page=0  chnl=15\n"
"char id=56   x=64    y=77    width=15    height=22    xoffset=0     yoffset=10    xadvance=16    page=0  chnl=15\n"
"char id=57   x=80    y=77    width=15    height=22    xoffset=1     yoffset=10    xadvance=16    page=0  chnl=15\n"
"char id=58   x=247   y=70    width=5     height=16    xoffset=2     yoffset=16    xadvance=9     page=0  chnl=15\n"
"char id=59   x=239   y=70    width=7     height=20    xoffset=0     yoffset=16    xadvance=9     page=0  chnl=15\n"
"char id=60   x=0     y=101   width=14    height=18    xoffset=1     yoffset=13    xadvance=16    page=0  chnl=15\n"
"char id=61   x=31    y=119   width=14    height=10    xoffset=1     yoffset=17    xadvance=16    page=0  chnl=15\n"
"char id=62   x=239   y=91    width=14    height=16    xoffset=1     yoffset=14    xadvance=16    page=0  chnl=15\n"
"char id=63   x=94    y=30    width=13    height=23    xoffset=1     yoffset=9     xadvance=15    page=0  chnl=15\n"
"char id=64   x=115   y=0     width=26    height=27    xoffset=1     yoffset=9     xadvance=29    page=0  chnl=15\n"
"char id=65   x=203   y=24    width=20    height=22    xoffset=0     yoffset=10    xadvance=19    page=0  chnl=15\n"
"char id=66   x=112   y=77    width=15    height=22    xoffset=2     yoffset=10    xadvance=18    page=0  chnl=15\n"
"char id=67   x=147   y=51    width=16    height=22    xoffset=1     yoffset=10    xadvance=17    page=0  chnl=15\n"
"char id=68   x=19    y=55    width=18    height=22    xoffset=2     yoffset=10    xadvance=20    page=0  chnl=15\n"
"char id=69   x=187   y=72    width=13    height=22    xoffset=2     yoffset=10    xadvance=16    page=0  chnl=15\n"
"char id=70   x=214   y=70    width=12    height=22    xoffset=2     yoffset=10    xadvance=15    page=0  chnl=15\n"
"char id=71   x=38    y=55    width=18    height=22    xoffset=1     yoffset=10    xadvance=20    page=0  chnl=15\n"
"char id=72   x=57    y=54    width=17    height=22    xoffset=2     yoffset=10    xadvance=20    page=0  chnl=15\n"
"char id=73   x=248   y=47    width=5     height=22    xoffset=2     yoffset=10    xadvance=8     page=0  chnl=15\n"
"char id=74   x=244   y=24    width=9     height=22    xoffset=0     yoffset=10    xadvance=10    page=0  chnl=15\n"
"char id=75   x=181   y=49    width=16    height=22    xoffset=2     yoffset=10    xadvance=18    page=0  chnl=15\n"
"char id=76   x=201   y=70    width=12    height=22    xoffset=2     yoffset=10    xadvance=13    page=0  chnl=15\n"
"char id=77   x=156   y=26    width=25    height=22    xoffset=2     yoffset=10    xadvance=28    page=0  chnl=15\n"
"char id=78   x=0     y=55    width=18    height=22    xoffset=2     yoffset=10    xadvance=21    page=0  chnl=15\n"
"char id=79   x=182   y=24    width=20    height=22    xoffset=1     yoffset=10    xadvance=22    page=0  chnl=15\n"
"char id=80   x=96    y=77    width=15    height=22    xoffset=2     yoffset=10    xadvance=17    page=0  chnl=15\n"
"char id=81   x=142   y=0     width=22    height=25    xoffset=1     yoffset=10    xadvance=22    page=0  chnl=15\n"
"char id=82   x=164   y=49    width=16    height=22    xoffset=2     yoffset=10    xadvance=18    page=0  chnl=15\n"
"char id=83   x=128   y=77    width=14    height=22    xoffset=1     yoffset=10    xadvance=15    page=0  chnl=15\n"
"char id=84   x=75    y=54    width=17    height=22    xoffset=0     yoffset=10    xadvance=16    page=0  chnl=15\n"
"char id=85   x=93    y=54    width=17    height=22    xoffset=2     yoffset=10    xadvance=21    page=0  chnl=15\n"
"char id=86   x=224   y=24    width=19    height=22    xoffset=0     yoffset=10    xadvance=19    page=0  chnl=15\n"
"char id=87   x=126   y=28    width=29    height=22    xoffset=0     yoffset=10    xadvance=29    page=0  chnl=15\n"
"char id=88   x=111   y=54    width=17    height=22    xoffset=0     yoffset=10    xadvance=18    page=0  chnl=15\n"
"char id=89   x=129   y=51    width=17    height=22    xoffset=0     yoffset=10    xadvance=17    page=0  chnl=15\n"
"char id=90   x=48    y=78    width=15    height=22    xoffset=0     yoffset=10    xadvance=15    page=0  chnl=15\n"
"char id=91   x=99    y=0     width=7     height=29    xoffset=2     yoffset=8     xadvance=10    page=0  chnl=15\n"
"char id=92   x=36    y=0     width=14    height=29    xoffset=0     yoffset=7     xadvance=14    page=0  chnl=15\n"
"char id=93   x=107   y=0     width=7     height=29    xoffset=1     yoffset=8     xadvance=10    page=0  chnl=15\n"
"char id=94   x=0     y=120   width=16    height=14    xoffset=0     yoffset=10    xadvance=16    page=0  chnl=15\n"
"char id=95   x=100   y=118   width=17    height=4     xoffset=0     yoffset=34    xadvance=16    page=0  chnl=15\n"
"char id=96   x=86    y=118   width=7     height=6     xoffset=1     yoffset=8     xadvance=9     page=0  chnl=15\n"
"char id=97   x=159   y=97    width=14    height=17    xoffset=1     yoffset=15    xadvance=16    page=0  chnl=15\n"
"char id=98   x=48    y=30    width=15    height=23    xoffset=2     yoffset=9     xadvance=17    page=0  chnl=15\n"
"char id=99   x=174   y=95    width=12    height=17    xoffset=1     yoffset=15    xadvance=13    page=0  chnl=15\n"
"char id=100  x=32    y=31    width=15    height=23    xoffset=1     yoffset=9     xadvance=17    page=0  chnl=15\n"
"char id=101  x=113   y=100   width=15    height=17    xoffset=1     yoffset=15    xadvance=16    page=0  chnl=15\n"
"char id=102  x=165   y=0     width=11    height=24    xoffset=0     yoffset=8     xadvance=10    page=0  chnl=15\n"
"char id=103  x=16    y=31    width=15    height=23    xoffset=0     yoffset=15    xadvance=15    page=0  chnl=15\n"
"char id=104  x=79    y=30    width=14    height=23    xoffset=2     yoffset=9     xadvance=17    page=0  chnl=15\n"
"char id=105  x=114   y=30    width=5     height=23    xoffset=1     yoffset=9     xadvance=8     page=0  chnl=15\n"
"char id=106  x=82    y=0     width=8     height=29    xoffset=0     yoffset=9     xadvance=8     page=0  chnl=15\n"
"char id=107  x=64    y=30    width=14    height=23    xoffset=2     yoffset=9     xadvance=15    page=0  chnl=15\n"
"char id=108  x=120   y=28    width=5     height=23    xoffset=2     yoffset=9     xadvance=8     page=0  chnl=15\n"
"char id=109  x=40    y=101   width=23    height=17    xoffset=2     yoffset=15    xadvance=26    page=0  chnl=15\n"
"char id=110  x=129   y=100   width=14    height=17    xoffset=2     yoffset=15    xadvance=17    page=0  chnl=15\n"
"char id=111  x=64    y=100   width=16    height=17    xoffset=1     yoffset=15    xadvance=17    page=0  chnl=15\n"
"char id=112  x=0     y=31    width=15    height=23    xoffset=2     yoffset=15    xadvance=17    page=0  chnl=15\n"
"char id=113  x=239   y=0     width=15    height=23    xoffset=1     yoffset=15    xadvance=17    page=0  chnl=15\n"
"char id=114  x=212   y=93    width=10    height=17    xoffset=2     yoffset=15    xadvance=11    page=0  chnl=15\n"
"char id=115  x=187   y=95    width=12    height=17    xoffset=1     yoffset=15    xadvance=13    page=0  chnl=15\n"
"char id=116  x=227   y=70    width=11    height=20    xoffset=0     yoffset=12    xadvance=11    page=0  chnl=15\n"
"char id=117  x=144   y=97    width=14    height=17    xoffset=1     yoffset=15    xadvance=17    page=0  chnl=15\n"
"char id=118  x=81    y=100   width=15    height=17    xoffset=0     yoffset=15    xadvance=15    page=0  chnl=15\n"
"char id=119  x=15    y=101   width=24    height=17    xoffset=0     yoffset=15    xadvance=24    page=0  chnl=15\n"
"char id=120  x=97    y=100   width=15    height=17    xoffset=0     yoffset=15    xadvance=15    page=0  chnl=15\n"
"char id=121  x=223   y=0     width=15    height=23    xoffset=0     yoffset=15    xadvance=15    page=0  chnl=15\n"
"char id=122  x=200   y=95    width=11    height=17    xoffset=1     yoffset=15    xadvance=13    page=0  chnl=15\n"
"char id=123  x=51    y=0     width=10    height=29    xoffset=0     yoffset=8     xadvance=11    page=0  chnl=15\n"
"char id=124  x=31    y=0     width=4     height=30    xoffset=5     yoffset=8     xadvance=15    page=0  chnl=15\n"
"char id=125  x=62    y=0     width=10    height=29    xoffset=1     yoffset=8     xadvance=11    page=0  chnl=15\n"
"char id=126  x=70    y=118   width=15    height=8     xoffset=0     yoffset=12    xadvance=16    page=0  chnl=15\n"
"kernings count=174\n"
"kerning first=65  second=84  amount=-2\n"
"kerning first=65  second=86  amount=-1\n"
"kerning first=65  second=87  amount=-1\n"
"kerning first=65  second=89  amount=-2\n"  
"kerning first=65  second=116 amount=-1\n"  
"kerning first=65  second=121 amount=-1\n"  
"kerning first=65  second=63  amount=-1\n"  
"kerning first=66  second=89  amount=-1\n"  
"kerning first=68  second=89  amount=-1\n"  
"kerning first=69  second=102 amount=-1\n"  
"kerning first=70  second=65  amount=-1\n"  
"kerning first=70  second=74  amount=-1\n"  
"kerning first=70  second=97  amount=-1\n"  
"kerning first=70  second=44  amount=-2\n"  
"kerning first=70  second=46  amount=-2\n"  
"kerning first=70  second=47  amount=-1\n"  
"kerning first=75  second=67  amount=-1\n"  
"kerning first=75  second=71  amount=-1\n"  
"kerning first=75  second=79  amount=-1\n"  
"kerning first=75  second=81  amount=-1\n"  
"kerning first=75  second=118 amount=-1\n"  
"kerning first=75  second=119 amount=-1\n"  
"kerning first=75  second=121 amount=-1\n"  
"kerning first=76  second=84  amount=-2\n"  
"kerning first=76  second=86  amount=-2\n"  
"kerning first=76  second=87  amount=-1\n"  
"kerning first=76  second=89  amount=-3\n"  
"kerning first=76  second=118 amount=-1\n"  
"kerning first=76  second=119 amount=-1\n"  
"kerning first=76  second=121 amount=-1\n"  
"kerning first=79  second=88  amount=-1\n"  
"kerning first=79  second=89  amount=-1\n"  
"kerning first=80  second=65  amount=-2\n"  
"kerning first=80  second=74  amount=-2\n"  
"kerning first=80  second=44  amount=-3\n"  
"kerning first=80  second=46  amount=-3\n"  
"kerning first=80  second=47  amount=-1\n"  
"kerning first=81  second=89  amount=-1\n"  
"kerning first=81  second=103 amount=1\n" 
"kerning first=81  second=106 amount=1\n"   
"kerning first=81  second=44  amount=1\n"   
"kerning first=81  second=59  amount=1\n"   
"kerning first=81  second=47  amount=1\n"   
"kerning first=84  second=65  amount=-2\n"  
"kerning first=84  second=71  amount=-1\n"  
"kerning first=84  second=74  amount=-1\n"  
"kerning first=84  second=79  amount=-1\n"  
"kerning first=84  second=81  amount=-1\n"  
"kerning first=84  second=97  amount=-2\n"  
"kerning first=84  second=99  amount=-2\n"  
"kerning first=84  second=100 amount=-2\n"  
"kerning first=84  second=101 amount=-2\n"  
"kerning first=84  second=103 amount=-2\n"  
"kerning first=84  second=109 amount=-1\n"  
"kerning first=84  second=110 amount=-1\n"  
"kerning first=84  second=111 amount=-2\n"  
"kerning first=84  second=112 amount=-1\n"  
"kerning first=84  second=113 amount=-2\n"  
"kerning first=84  second=114 amount=-1\n"  
"kerning first=84  second=115 amount=-2\n"  
"kerning first=84  second=117 amount=-1\n"  
"kerning first=84  second=118 amount=-1\n"  
"kerning first=84  second=119 amount=-1\n"  
"kerning first=84  second=120 amount=-1\n"  
"kerning first=84  second=121 amount=-1\n"  
"kerning first=84  second=122 amount=-1\n"  
"kerning first=84  second=44  amount=-3\n"  
"kerning first=84  second=59  amount=-1\n"  
"kerning first=84  second=58  amount=-1\n"  
"kerning first=84  second=46  amount=-2\n"  
"kerning first=84  second=47  amount=-2\n"  
"kerning first=85  second=65  amount=-1\n"  
"kerning first=86  second=65  amount=-1\n"  
"kerning first=86  second=74  amount=-1\n"  
"kerning first=86  second=97  amount=-1\n"  
"kerning first=86  second=99  amount=-1\n"  
"kerning first=86  second=100 amount=-1\n"  
"kerning first=86  second=101 amount=-1\n"  
"kerning first=86  second=103 amount=-1\n"  
"kerning first=86  second=109 amount=-1\n"  
"kerning first=86  second=110 amount=-1\n"  
"kerning first=86  second=111 amount=-1\n"  
"kerning first=86  second=112 amount=-1\n"  
"kerning first=86  second=113 amount=-1\n"  
"kerning first=86  second=114 amount=-1\n"  
"kerning first=86  second=115 amount=-1\n"  
"kerning first=86  second=117 amount=-1\n"  
"kerning first=86  second=122 amount=-1\n"  
"kerning first=86  second=44  amount=-2\n"  
"kerning first=86  second=59  amount=-1\n"  
"kerning first=86  second=58  amount=-1\n"  
"kerning first=86  second=46  amount=-3\n"  
"kerning first=86  second=47  amount=-1\n"  
"kerning first=87  second=65  amount=-1\n"  
"kerning first=87  second=74  amount=-1\n"  
"kerning first=87  second=97  amount=-1\n"  
"kerning first=87  second=99  amount=-1\n"  
"kerning first=87  second=100 amount=-1\n"  
"kerning first=87  second=101 amount=-1\n"  
"kerning first=87  second=103 amount=-1\n"  
"kerning first=87  second=109 amount=-1\n"  
"kerning first=87  second=110 amount=-1\n"  
"kerning first=87  second=111 amount=-1\n"  
"kerning first=87  second=112 amount=-1\n"  
"kerning first=87  second=113 amount=-1\n"  
"kerning first=87  second=114 amount=-1\n"  
"kerning first=87  second=115 amount=-1\n"  
"kerning first=87  second=117 amount=-1\n"  
"kerning first=87  second=44  amount=-2\n"  
"kerning first=87  second=59  amount=-1\n"  
"kerning first=87  second=46  amount=-2\n"  
"kerning first=88  second=67  amount=-1\n"  
"kerning first=88  second=71  amount=-1\n"  
"kerning first=88  second=79  amount=-1\n"  
"kerning first=88  second=81  amount=-1\n"  
"kerning first=88  second=118 amount=-1\n"  
"kerning first=88  second=119 amount=-1\n"  
"kerning first=88  second=121 amount=-1\n"  
"kerning first=89  second=65  amount=-2\n"  
"kerning first=89  second=67  amount=-1\n"  
"kerning first=89  second=71  amount=-1\n"  
"kerning first=89  second=74  amount=-1\n"  
"kerning first=89  second=79  amount=-1\n"  
"kerning first=89  second=81  amount=-1\n"  
"kerning first=89  second=97  amount=-2\n"  
"kerning first=89  second=99  amount=-2\n"  
"kerning first=89  second=100 amount=-2\n"  
"kerning first=89  second=101 amount=-2\n"  
"kerning first=89  second=102 amount=-1\n"  
"kerning first=89  second=103 amount=-2\n"  
"kerning first=89  second=109 amount=-1\n"  
"kerning first=89  second=110 amount=-1\n"  
"kerning first=89  second=111 amount=-2\n"  
"kerning first=89  second=112 amount=-1\n"  
"kerning first=89  second=113 amount=-2\n"  
"kerning first=89  second=114 amount=-1\n"  
"kerning first=89  second=115 amount=-2\n"  
"kerning first=89  second=117 amount=-1\n"  
"kerning first=89  second=118 amount=-1\n"  
"kerning first=89  second=119 amount=-1\n"  
"kerning first=89  second=120 amount=-1\n"  
"kerning first=89  second=121 amount=-1\n"  
"kerning first=89  second=122 amount=-1\n"  
"kerning first=89  second=44  amount=-3\n"  
"kerning first=89  second=59  amount=-2\n"  
"kerning first=89  second=58  amount=-2\n"  
"kerning first=89  second=46  amount=-3\n"  
"kerning first=89  second=47  amount=-2\n"  
"kerning first=102 second=44  amount=-1\n"  
"kerning first=102 second=46  amount=-1\n"  
"kerning first=103 second=47  amount=1\n"   
"kerning first=107 second=101 amount=-1\n"  
"kerning first=107 second=111 amount=-1\n"  
"kerning first=114 second=44  amount=-2\n"  
"kerning first=114 second=46  amount=-3\n"  
"kerning first=118 second=44  amount=-2\n"  
"kerning first=118 second=46  amount=-2\n"  
"kerning first=119 second=44  amount=-2\n"  
"kerning first=119 second=46  amount=-2\n"  
"kerning first=121 second=44  amount=-2\n"  
"kerning first=121 second=46  amount=-2\n"  
"kerning first=44  second=84  amount=-1\n"  
"kerning first=44  second=86  amount=-1\n"  
"kerning first=44  second=87  amount=-1\n"  
"kerning first=44  second=89  amount=-2\n"  
"kerning first=46  second=84  amount=-2\n"  
"kerning first=46  second=86  amount=-2\n"  
"kerning first=46  second=87  amount=-1\n"  
"kerning first=46  second=89  amount=-3\n"  
"kerning first=46  second=118 amount=-1\n"  
"kerning first=46  second=119 amount=-1\n"  
"kerning first=46  second=121 amount=-1\n"  
"kerning first=47  second=65  amount=-1\n"  
"kerning first=47  second=115 amount=-1\n";
